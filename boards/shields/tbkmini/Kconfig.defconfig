## boards/shields/tbkmini/Kconfig.defconfig
```kconfig
if SHIELD_TBKMINI_DONGLE

config ZMK_KEYBOARD_NAME
        default "TBK Mini"

config ZMK_SPLIT_ROLE_CENTRAL
        default y

config ZMK_SPLIT
        default y

config ZMK_SPLIT_BLE_CENTRAL_PERIPHERALS
    default 2

config BT_MAX_CONN
    default 7

config BT_MAX_PAIRED
    default 7

endif

if SHIELD_TBKMINI_LEFT || SHIELD_TBKMINI_RIGHT

config ZMK_SPLIT
        default y

endif
```

## boards/shields/tbkmini/Kconfig.shield
```kconfig
config SHIELD_TKBMINI_LEFT
	def_bool $(shields_list_contains,tbkmini_left)

config SHIELD_TKBMINI_RIGHT
	def_bool $(shields_list_contains,tbkmini_right)

config SHIELD_TBKMINI_DONGLE
	def_bool $(shields_list_contains,tbkmini_dongle)
	
```

## config/boards/shields/board/tbkmini/Kconfig.defconfig
```kconfig
if SHIELD_TBKMINI_LEFT

config ZMK_KEYBOARD_NAME
        default "TBK Mini Left"

config ZMK_SPLIT_BLE_ROLE_CENTRAL
        default y

endif

if SHIELD_TBKMINI_RIGHT

config ZMK_KEYBOARD_NAME
        default "TBK Mini Right"

endif

if SHIELD_TBKMINI_LEFT || SHIELD_TBKMINI_RIGHT

config ZMK_SPLIT
        default y

endif
```

## config/boards/shields/tbkmini/Kconfig.defconfig
```kconfig
if SHIELD_TBKMINI_DONGLE

config ZMK_KEYBOARD_NAME
        default "TBK Mini"

config ZMK_SPLIT_BLE_ROLE_CENTRAL
        default y

config ZMK_USB
        default y

endif

if SHIELD_TBKMINI_LEFT || SHIELD_TBKMINI_RIGHT || SHIELD_TBKMINI_DONGLE

config ZMK_SPLIT
        default y

config ZMK_BLE
        default y

endif
```
